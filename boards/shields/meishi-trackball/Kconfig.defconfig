## boards/shields/meishi-trackball/Kconfig.defconfig
```kconfig
if SHIELD_MEISHI_TRACKBALL

config ZMK_KEYBOARD_NAME
	default "Trackball BLE"

if ZMK_DISPLAY

config I2C
	default y

config SSD1306
	default y

config SSD1306_REVERSE_MODE
	default y

endif # ZMK_DISPLAY

endif
```

## boards/shields/meishi-trackball/Kconfig.shield
```kconfig
config SHIELD_MEISHI_TRACKBALL
	def_bool $(shields_list_contains,meishi-trackball)
```

## config/west.yml
```yaml
manifest:
  remotes:
    - name: zmkfirmware
      url-base: https://github.com/petejohanson
    - name: love-444
      url-base: https://github.com/love-444
  projects:
    - name: zmk
      remote: zmkfirmware
      revision: feat/pointers-move-scroll
      import: app/west.yml
    - name: zmk-pmw3610-driver
      remote: love-444
      revision: main
  self:
    path: config
```
